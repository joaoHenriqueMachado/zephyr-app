## boards/stm32f429i_disc1.conf
```kconfig
# Misc
CONFIG_HEAP_MEM_POOL_SIZE=16384
CONFIG_SHELL_STACK_SIZE=8192

# Enable Shell
CONFIG_SHELL=y

# Setting the Shell prompt
CONFIG_SHELL_PROMPT_UART="se28cp$ "

# Setting the max argc
CONFIG_SHELL_ARGC_MAX=12

# Enable the Zephyr boot banner
CONFIG_BOOT_BANNER=y

CONFIG_THREAD_RUNTIME_STATS=y

CONFIG_ZBUS=y
CONFIG_ZBUS_LOG_LEVEL_INF=y
CONFIG_ZBUS_CHANNEL_NAME=y
CONFIG_ZBUS_OBSERVER_NAME=y
CONFIG_ZBUS_RUNTIME_OBSERVERS=y
CONFIG_GPIO=y
CONFIG_CMSIS_DSP=y
CONFIG_NEWLIB_LIBC=y
CONFIG_FPU=y
CONFIG_NEWLIB_LIBC_FLOAT_PRINTF=y
```
